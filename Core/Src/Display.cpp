#include <stdint.h>
#include <string.h>
#include <stdio.h>
#include "Display.h"
#include "stm32f4xx_hal.h"
#include "main.h"
#include "rocketcat.h"

#define DELAY 0x80
#define COL0(r, g, b) ((((r) >> 3) << 11) | (((g) >> 2) << 5) | ((b) >> 3))
#define COL(c) COL0((c >> 16) & 0xff, (c >> 8) & 0xff, c & 0xff)

const uint8_t font8[] = {
0x00, 0x00, 0x00, 0x00, 0x00, 0x00, 
0x00, 0x00, 0x5e, 0x00, 0x00, 0x00, 
0x00, 0x0e, 0x00, 0x0e, 0x00, 0x00, 
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0x00, 0x00, 0x00, 0x00, 0x00, 0x00, 
};

extern SPI_HandleTypeDef hspi2;

uint16_t fb[DISPLAY_WIDTH * DISPLAY_HEIGHT];

static const uint8_t initCmds[] = {
    ST7735_SWRESET,   DELAY,  //  1: Software reset, 0 args, w/delay
      120,                    //     150 ms delay
    ST7735_SLPOUT ,   DELAY,  //  2: Out of sleep mode, 0 args, w/delay
      120,                    //     500 ms delay
    ST7735_INVOFF , 0      ,  // 13: Don't invert display, no args, no delay
    ST7735_INVCTR , 1      ,  // inverse, riven
      0x03,
    ST7735_COLMOD , 1      ,  // 15: set color mode, 1 arg, no delay:
      0x05,                  //     16-bit color
    ST7735_GMCTRP1, 16      , //  1: Magical unicorn dust, 16 args, no delay:
      0x02, 0x1c, 0x07, 0x12,
      0x37, 0x32, 0x29, 0x2d,
      0x29, 0x25, 0x2B, 0x39,
      0x00, 0x01, 0x03, 0x10,
    ST7735_GMCTRN1, 16      , //  2: Sparkles and rainbows, 16 args, no delay:
      0x03, 0x1d, 0x07, 0x06,
      0x2E, 0x2C, 0x29, 0x2D,
      0x2E, 0x2E, 0x37, 0x3F,
      0x00, 0x00, 0x02, 0x10,
    ST7735_NORON  ,    DELAY, //  3: Normal display on, no args, w/delay
      10,                     //     10 ms delay
    ST7735_DISPON ,    DELAY, //  4: Main screen turn on, no args w/delay
      10,
    0, 0 // END
};

void Display::sendCmdSeq(const uint8_t *buf) {
    char cmdBuf[20] = {};
    while (*buf) {
        cmdBuf[0] = *buf++;
        int v = *buf++;
        int len = v & ~DELAY;
        // note that we have to copy to RAM
        memcpy(cmdBuf + 1, buf, len);
        sendCmd((uint8_t*)cmdBuf, len + 1);
        buf += len;
        if (v & DELAY) {
            HAL_Delay(*buf++);
        }
    }
}

void Display::setCS(bool value) {
    HAL_GPIO_WritePin(DisplayCS_GPIO_Port, DisplayCS_Pin, static_cast<GPIO_PinState>(value));
}

void Display::setDC(bool value) {
    HAL_GPIO_WritePin(DisplayDC_GPIO_Port, DisplayDC_Pin, static_cast<GPIO_PinState>(value));
}

void Display::setBacklight(bool value) {
    HAL_GPIO_WritePin(DisplayBL_GPIO_Port, DisplayBL_Pin, static_cast<GPIO_PinState>(value));
}

void Display::reset() {
    HAL_GPIO_WritePin(DisplayRst_GPIO_Port, DisplayRst_Pin, GPIO_PIN_RESET);
    HAL_Delay(20);
    HAL_GPIO_WritePin(DisplayRst_GPIO_Port, DisplayRst_Pin, GPIO_PIN_SET);
    HAL_Delay(20);
}

void Display::sendCmd(uint8_t* buf, int len) {
    this->setDC(0);
    this->setCS(0);

    HAL_SPI_Transmit(&hspi2, buf, 1, 1000);

    this->setDC(1);

    len--;
    buf++;
    if (len > 0) {
        HAL_SPI_Transmit(&hspi2, buf, len, 1000);
    }

    this->setCS(1);
}

void Display::configure(uint8_t madctl, uint32_t frmctr1) {
    uint8_t cmd0[] = {ST7735_MADCTL, madctl};
    uint8_t cmd1[] = {ST7735_FRMCTR1, (uint8_t)(frmctr1 >> 16), (uint8_t)(frmctr1 >> 8),
                      (uint8_t)frmctr1};
    this->sendCmd(cmd0, sizeof(cmd0));
    this->sendCmd(cmd1, cmd1[3] == 0xff ? 3 : 4);
}

void Display::setAddrWindow(int x, int y, int w, int h) {
    uint8_t cmd0[] = {ST7735_RASET, 0, x, 0, y + h - 1};
    uint8_t cmd1[] = {ST7735_CASET, 0, y, 0, x + w - 1};
    this->sendCmd(cmd1, sizeof(cmd1));
    this->sendCmd(cmd0, sizeof(cmd0));
}

void Display::draw() {
    char cmd[] = {ST7735_RAMWR};
    sendCmd(cmd, 1);

    this->setDC(1);
    this->setCS(0);

    for (size_t i = 0; i < sizeof fb / sizeof (fb[0]); i++) {
	    int x = i % DISPLAY_WIDTH;
	    int y = i / DISPLAY_WIDTH;

	    uint16_t pixel = fb[i];

	    for (int i=0;i<spriteCount;i++) {
		Sprite& sprite = sprites[i];

		if (x > (sprite.getX() - 8) && x < (sprite.getX() + 8) &&
		    y > (sprite.getY() - 8) && y < (sprite.getY() + 8) && 
		    !sprite.isTransparent(sprite.getX() - x + 8, sprite.getY() - y + 8)) {
		    pixel = sprite.getPixelAt(sprite.getX() - x + 8, sprite.getY() - y + 8);
		}
	    }

	    *(volatile uint8_t*)&SPI2->DR = pixel >> 8;
	    while((SPI2->SR & (SPI_SR_TXE | SPI_SR_BSY)) != SPI_SR_TXE);
	    *(volatile uint8_t*)&SPI2->DR = pixel & 0xFF;
	    while((SPI2->SR & (SPI_SR_TXE | SPI_SR_BSY)) != SPI_SR_TXE);
    }

    this->setCS(1);
}

void Display::drawLogo() {
    memcpy(fb, rocketcat.pixel_data, sizeof fb);
}

void Display::init() {
    setCS(1);
    setDC(1);
    reset();

    sendCmdSeq(initCmds);

    setBacklight(1);

    uint32_t cfg0 = 0x40 | 0x20;
    uint32_t frmctr1 = 0x16; 
    uint32_t madctl = cfg0 & 0xff; // 64
    uint32_t offX = (cfg0 >> 8) & 0xff; // 0
    uint32_t offY = (cfg0 >> 16) & 0xff; // 0

    configure(madctl, frmctr1);
    setAddrWindow(offX, offY, DISPLAY_WIDTH, DISPLAY_HEIGHT);

    memset(fb, 0, sizeof fb);

    drawLogo();
    //draw();
}

Sprite& Display::getSprite(int index) {
    return sprites[index];
}

Sprite& Display::newSprite(uint16_t transparency, uint16_t data[16*16]) {
    sprites[spriteCount] = Sprite(transparency, data);

    return sprites[spriteCount++];
}
